## config/boards/shields/side_b/Kconfig.defconfig
```kconfig
if SHIELD_side_b_R

config ZMK_KEYBOARD_NAME
    default "side_b_R"

config ZMK_SPLIT
    default y

config ZMK_SPLIT_ROLE_CENTRAL
    default y

endif

if SHIELD_side_b_L

config ZMK_KEYBOARD_NAME
    default "side_b_L"

config ZMK_SPLIT
    default y

endif
```

## config/boards/shields/side_b/Kconfig.shield
```kconfig
config SHIELD_side_b_R
    def_bool $(shields_list_contains,side_b_R)

config SHIELD_side_b_L
    def_bool $(shields_list_contains,side_b_L)
```
